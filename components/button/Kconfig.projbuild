## components/button/Kconfig.projbuild
```kconfig
menu "TGVR/Button"
    config BUTTON_PIN
        int "Button GPIO pin"
        default 21

    config DEBOUNCE_TIME_MS
        int "Button Debounce Time (ms)"
        default 50
endmenu
```

## components/microphone/Kconfig.projbuild
```kconfig
menu "TGVR/Microphone"
    menu "GPIO"
        config SCK
            int "SCK pin"
            default 1

        config WS
            int "WS pin"
            default 2

        config SD
            int "SD pin"
            default 3
    endmenu

    menu "Audio"
        config SAMPLE_RATE
            int "Sample Rate"
            default 48000

        config WRITE_FREQ_MS
            int "Write Frequency (ms)"
            default 10

        config FILTER_BITS
            int "Number of lowest bits to remove"
            default 11
    endmenu
endmenu
```

## components/sd/Kconfig.projbuild
```kconfig
menu "TGVR/SD"
    config SCLK
        int "SCLK pin"
        default 4

    config MISO
        int "MISO pin"
        default 5

    config MOSI
        int "MOSI pin"
        default 6

    config CS
        int "CS pin"
        default 7
endmenu
```

## components/telegram/Kconfig.projbuild
```kconfig
menu "TGVR/Telegram"
    config BOT_TOKEN
        string "Bot token"
        default "1234567:ABC-DEF1234ghIkl-zyx57W2v1u123ew11"

    config CHAT_ID
        string "Chat ID"
        default "1234567"
endmenu
```

## components/wifi/Kconfig.projbuild
```kconfig
menu "TGVR/WiFi"
    config SSID
        string "SSID"
        default "myssid"
    
    config WIFI_PASSWORD
        string "Password"
        default "mypassword"
endmenu
```
